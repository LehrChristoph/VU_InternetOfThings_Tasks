## CMakeLists.txt
```
cmake_minimum_required(VERSION 3.20.0)

cmake_minimum_required(VERSION 3.20.0)

# IMPORTANT Switch toolchain
set(ZEPHYR_TOOLCHAIN_VARIANT "espressif")
set(CMAKE_EXPORT_COMPILE_COMMANDS ON)

# set board variable to thingy:52
#set(BOARD "thingy52_nrf52832")
set(BOARD "esp32")

find_package(Zephyr REQUIRED HINTS $ENV{ZEPHYR_BASE})

project(mqtt_gateway)
target_include_directories(app PRIVATE inc)

target_sources(app PRIVATE src/main.c)
target_sources(app PRIVATE src/wifi_handler.c)
target_sources(app PRIVATE src/mqtt_handler.c)
target_sources(app PRIVATE src/bt_handler.c)

# I'm not sure why, but this is required for ESP32
zephyr_library_include_directories(${ZEPHYR_BASE}/samples/bluetooth)
```

## prj.conf
```kconfig
CONFIG_GPIO=y
#CONFIG_I2C=y
CONFIG_GEN_ISR_TABLES=y
# CONFIG_GEN_IRQ_VECTOR_TABLE is not set
CONFIG_SYS_CLOCK_HW_CYCLES_PER_SEC=240000000
# CONFIG_XTENSA_RESET_VECTOR is not set
# CONFIG_XTENSA_USE_CORE_CRT1 is not set
#CONFIG_MAIN_STACK_SIZE=2048
CONFIG_MAIN_STACK_SIZE=1900
CONFIG_CONSOLE=y
CONFIG_CONSOLE_INIT_PRIORITY=60
CONFIG_SERIAL=y
#CONFIG_PINMUX=y
#CONFIG_PINMUX_ESP32=y

CONFIG_BOOTLOADER_ESP_IDF=y

CONFIG_FPU=y

CONFIG_CBPRINTF_FP_SUPPORT=y

# Bluetooth
CONFIG_BT=y
CONFIG_BT_CENTRAL=y
#CONFIG_BT_DEVICE_NAME_DYNAMIC=y
CONFIG_BT_DEVICE_NAME="ESP32"
CONFIG_BT_GATT_CLIENT=y
#CONFIG_BT_DEBUG_LOG=y

# Networking
#CONFIG_HEAP_MEM_POOL_SIZE=98304
CONFIG_HEAP_MEM_POOL_SIZE=86016

CONFIG_NETWORKING=y
CONFIG_NET_L2_ETHERNET=y

CONFIG_NET_HOSTNAME_ENABLE=y
CONFIG_NET_HOSTNAME="EPS32-zephyr"

CONFIG_NET_IPV6=n
CONFIG_NET_IPV4=y
CONFIG_NET_DHCPV4=y
CONFIG_NET_TCP=y
CONFIG_NET_SOCKETS=y

CONFIG_NET_MGMT=y
CONFIG_NET_MGMT_EVENT=y

CONFIG_NET_LOG=n
CONFIG_NET_SHELL=n

CONFIG_MBEDTLS=y
CONFIG_MBEDTLS_ENTROPY_ENABLED=y
CONFIG_MBEDTLS_KEY_EXCHANGE_ECDHE_ECDSA_ENABLED=y
CONFIG_MBEDTLS_ECP_ALL_ENABLED=y

# Wifi
CONFIG_WIFI=y
CONFIG_WIFI_ESP32=y

CONFIG_ESP32_WIFI_SSID="WLAN"
CONFIG_ESP32_WIFI_PASSWORD="pw"

# MQTT
CONFIG_MQTT_LIB=y
#CONFIG_MQTT_LIB_TLS=y
#CONFIG_MQTT_LIB_WEBSOCKET=y
```

## src/main.c
```c
/* main.c - Application main entry point */

/*
 * Copyright (c) 2015-2016 Intel Corporation
 *
 * SPDX-License-Identifier: Apache-2.0
 */

#include <zephyr/types.h>
#include <stdio.h>
#include <zephyr.h>

#include "handlers.h"
#include "kernel.h"

void main(void)
{
	wifi_handler_connect(true);
	bt_handler_init();
	bt_handler_set_sampling_interval(1000);
	while(mqtt_handler_connect())
	{
		k_msleep(1000);
	}

    bool send = false;
    mqtt_set_send(&send);

	while(true)
	{
        // bt_get_temp() returns the last correct reading
        if (send)
        {
            if(bt_handler_fetch_data())
            {
                break;
            }
            if(mqtt_handler_publish(bt_get_temp()))
            {
                break;
            }
            send = false;

        }
        else
        {
            if (mqtt_handler_keep_alive())
            {
                break;
            }
        }
		/* k_msleep(10000); */

        uint64_t start = k_uptime_get();
        while (k_uptime_get() - start < 1000 && !send)
        {
        }
	}

	mqtt_handler_disconnect();

}
```

## inc/handlers.h
```c
#ifndef APP_HANDLERS_H
#define APP_HANDLERS_H

// Bluetooth handler
int bt_handler_init(void);
int bt_handler_fetch_data(void);
int bt_handler_set_sampling_interval(unsigned int ms);
double bt_get_temp();

// WIFI handler
void wifi_handler_connect(bool wait_for_connection);

// MQTT Handler
int mqtt_handler_connect(void);
int mqtt_handler_publish(double);
int mqtt_handler_disconnect(void);
int mqtt_handler_keep_alive(void);
void mqtt_set_send(bool *send);

#endif
```

## inc/mqtt_config.h
```c
/*
 * Copyright (c) 2017 Intel Corporation
 *
 * SPDX-License-Identifier: Apache-2.0
 */

#ifndef __CONFIG_H__
#define __CONFIG_H__


//#define SERVER_ADDR		"broker.hivemq.com"
#define SERVER_ADDR		"3.65.154.195"

#define SERVER_PORT		1883
//#define SERVER_PORT		8000

#define APP_CONNECT_TIMEOUT_MS	2000
#define APP_SLEEP_MSECS		500

#define APP_CONNECT_TRIES	10

#define APP_MQTT_BUFFER_SIZE	128

#define MQTT_CLIENTID		"vu_iot_group2_zephyr_esp32_123"
#define MQTT_TOPIC  "tuwien_vu_iot/2021W/assignment3/group2/temperature"
#define MQTT_SUB_TOPIC  "tuwien_vu_iot/2021W/assignment3/group2/temperature_req"
#endif
```

## src/bt_handler.c
```c
/* main.c - Application main entry point */

/*
 * Copyright (c) 2015-2016 Intel Corporation
 *
 * SPDX-License-Identifier: Apache-2.0
 */

#include <zephyr/types.h>
#include <stdio.h>
#include <zephyr.h>

#include <bluetooth/bluetooth.h>
#include <bluetooth/hci.h>
#include <bluetooth/conn.h>
#include <bluetooth/uuid.h>
#include <bluetooth/gatt.h>
#include <sys/byteorder.h>

double actual_temp;

///////////////////////////////////////////////////////////////////////////////

static void start_scan(void);

uint8_t read_temp_func(struct bt_conn *conn, uint8_t err, struct bt_gatt_read_params *params,
			const void *data, uint16_t length);

void write_temp_range_func(struct bt_conn *conn, uint8_t err, struct bt_gatt_write_params *params);

///////////////////////////////////////////////////////////////////////////////

static struct bt_conn *default_conn;

static struct bt_uuid_16 uuid = BT_UUID_INIT_16(0);
static struct bt_gatt_discover_params discover_params;
static struct bt_gatt_subscribe_params subscribe_params;
static struct bt_gatt_read_params read_temp_params =
{
	// configure read params
	.func = read_temp_func,
	.handle_count = 0,
	.by_uuid.start_handle = BT_ATT_FIRST_ATTRIBUTE_HANDLE,
	.by_uuid.end_handle = BT_ATT_LAST_ATTRIBUTE_HANDLE,
	.by_uuid.uuid = BT_UUID_TEMPERATURE,
};

static unsigned int interval;

static struct bt_gatt_write_params write_temp_params =
{
	.func = write_temp_range_func,
	.data = &interval,
	.length = sizeof(interval),
	.offset = 0,
};

static struct bt_conn *conn_device;

///////////////////////////////////////////////////////////////////////////////

double bt_get_temp()
{
    return actual_temp;
}

uint8_t read_temp_func(struct bt_conn *conn, uint8_t err, struct bt_gatt_read_params *params,
			const void *data, uint16_t length)
{
	if(length == sizeof(double))
	{
		const double *test= data;
		printk("[READ] data %g length %u\n", *test, length);

        actual_temp = *test;
	}
	return BT_GATT_ITER_STOP;
}

void write_temp_range_func(struct bt_conn *conn, uint8_t err, struct bt_gatt_write_params *params)
{
	const unsigned int *value = params->data;
	printk("[WRITE] data %u , error code: %u\n", *value, -err);
}

static uint8_t discover_func(struct bt_conn *conn,
			     const struct bt_gatt_attr *attr,
			     struct bt_gatt_discover_params *params)
{
	int err;

	if (!attr) {
		printk("Discover complete\n");
		(void)memset(params, 0, sizeof(*params));
		conn_device = conn;
		return BT_GATT_ITER_STOP;
	}

	printk("[ATTRIBUTE] handle %u\n", attr->handle);

	if (!bt_uuid_cmp(discover_params.uuid, BT_UUID_ESS)) {
		memcpy(&uuid, BT_UUID_TEMPERATURE, sizeof(uuid));
		discover_params.uuid = &uuid.uuid;
		discover_params.start_handle = attr->handle + 1;
		discover_params.type = BT_GATT_DISCOVER_CHARACTERISTIC;

		printk("Discovered service\n");

		err = bt_gatt_discover(conn, &discover_params);
		if (err) {
			printk("Discover failed (err %d)\n", err);
		}
	}
	else if (!bt_uuid_cmp(discover_params.uuid, BT_UUID_TEMPERATURE)) {
		printk("Discovered Temperature\n");

		memcpy(&uuid, BT_UUID_ES_TRIGGER_SETTING, sizeof(uuid));
		discover_params.uuid = &uuid.uuid;
		discover_params.start_handle = attr->handle + 1;
		discover_params.type = BT_GATT_DISCOVER_CHARACTERISTIC;

		err = bt_gatt_discover(conn, &discover_params);
		if (err) {
			printk("Discover failed (err %d)\n", err);
		}
	}
	else if (!bt_uuid_cmp(discover_params.uuid, BT_UUID_ES_TRIGGER_SETTING))
	{

		printk("Discovered Range\n");
		write_temp_params.handle = attr->handle +1;

		memcpy(&uuid, BT_UUID_GATT_CCC, sizeof(uuid));
		discover_params.uuid = &uuid.uuid;
		discover_params.start_handle = attr->handle + 1;
		discover_params.type = BT_GATT_DISCOVER_CHARACTERISTIC;

		err = bt_gatt_discover(conn, &discover_params);
		if (err) {
			printk("Discover failed (err %d)\n", err);
		}

	}

	return BT_GATT_ITER_STOP;
}


static void device_found(const bt_addr_le_t *addr, int8_t rssi, uint8_t type,
			 struct net_buf_simple *ad)
{
	char addr_str[BT_ADDR_LE_STR_LEN];
	int err;

	if (default_conn) {
		return;
	}

	/* We're only interested in connectable events */
	if (type != BT_GAP_ADV_TYPE_ADV_IND &&
	    type != BT_GAP_ADV_TYPE_ADV_DIRECT_IND) {
		return;
	}

	bt_addr_le_to_str(addr, addr_str, sizeof(addr_str));
	printk("Device found: %s (RSSI %d)\n", addr_str, rssi);

	/* connect only to devices in close proximity */
	if (rssi < -70) {
		return;
	}

	if (bt_le_scan_stop()) {
		return;
	}

	err = bt_conn_le_create(addr, BT_CONN_LE_CREATE_CONN,
				BT_LE_CONN_PARAM_DEFAULT, &default_conn);
	if (err) {
		printk("Create conn to %s failed (%u)\n", addr_str, err);
		start_scan();
	}
}

static void start_scan(void)
{
	int err;

	/* This demo doesn't require active scan */
	err = bt_le_scan_start(BT_LE_SCAN_PASSIVE, device_found);
	if (err) {
		printk("Scanning failed to start (err %d)\n", err);
		return;
	}

	printk("Scanning successfully started\n");
}

static void connected(struct bt_conn *conn, uint8_t err)
{
	char addr[BT_ADDR_LE_STR_LEN];

	bt_addr_le_to_str(bt_conn_get_dst(conn), addr, sizeof(addr));

	if (err) {
		printk("Failed to connect to %s (%u)\n", addr, err);

		bt_conn_unref(default_conn);
		default_conn = NULL;

		start_scan();
		return;
	}

	if (conn != default_conn) {
		return;
	}

	printk("Connected: %s\n", addr);

	memcpy(&uuid, BT_UUID_ESS, sizeof(uuid));
	discover_params.uuid = &uuid.uuid;
	discover_params.func = discover_func;
	discover_params.start_handle = BT_ATT_FIRST_ATTRIBUTE_HANDLE;
	discover_params.end_handle = BT_ATT_LAST_ATTRIBUTE_HANDLE;
	discover_params.type = BT_GATT_DISCOVER_PRIMARY;

	err = bt_gatt_discover(default_conn, &discover_params);
	if (err) {
		printk("Discover failed(err %d)\n", err);
		return;
	}
}

static void disconnected(struct bt_conn *conn, uint8_t reason)
{
	char addr[BT_ADDR_LE_STR_LEN];

	if (conn != default_conn) {
		return;
	}

	bt_addr_le_to_str(bt_conn_get_dst(conn), addr, sizeof(addr));

	printk("Disconnected: %s (reason 0x%02x)\n", addr, reason);

	bt_conn_unref(default_conn);
	default_conn = NULL;

	start_scan();
}

BT_CONN_CB_DEFINE(conn_callbacks) = {
	.connected = connected,
	.disconnected = disconnected,
};

int bt_handler_init(void)
{
	int err;

	err = bt_enable(NULL);
	if (err) {
		printk("Bluetooth init failed (err %d)\n", err);
		return err;
	}

	printk("Bluetooth initialized\n");

	start_scan();

	while(conn_device == NULL)
	{
		k_msleep(1000);
	}

	printk("Device connected\n");

	return 0;
}

int bt_handler_fetch_data(void)
{
	return bt_gatt_read(conn_device, &read_temp_params);
}

int bt_handler_set_sampling_interval(unsigned int ms)
{
	interval = ms;
	return bt_gatt_write(conn_device, &write_temp_params);
}
```

## src/mqtt_handler.c
```c
/*
 * Copyright (c) 2017 Intel Corporation
 *
 * SPDX-License-Identifier: Apache-2.0
 */

#include <logging/log.h>
LOG_MODULE_REGISTER(net_mqtt_publisher_sample, LOG_LEVEL_DBG);

#include <zephyr.h>
#include <net/socket.h>
#include <net/mqtt.h>
#include <random/rand32.h>

#include <string.h>
#include <errno.h>
#include <stdio.h>

#include "handlers.h"
#include "mqtt_config.h"
///////////////////////////////////////////////////////////////////////////////

#define APP_BMEM
#define APP_DMEM

/* Buffers for MQTT client. */
static APP_BMEM uint8_t rx_buffer[APP_MQTT_BUFFER_SIZE];
static APP_BMEM uint8_t tx_buffer[APP_MQTT_BUFFER_SIZE];

/* The mqtt client struct */
static APP_BMEM struct mqtt_client client_ctx;
static char clientID[MQTT_CLIENTID_TOTAL_LENGTH]; 

#if defined(CONFIG_MQTT_LIB_WEBSOCKET)
#define MQTT_LIB_WEBSOCKET_RECV_BUF_LEN 1280

/* Websocket needs temporary buffer to store partial packets */
static APP_BMEM uint8_t temp_ws_rx_buf[MQTT_LIB_WEBSOCKET_RECV_BUF_LEN];
#endif

/* MQTT Broker details. */
static APP_BMEM struct sockaddr_storage broker;

static APP_BMEM struct zsock_pollfd fds[1];
static APP_BMEM int nfds;

static APP_BMEM bool connected;

///////////////////////////////////////////////////////////////////////////////

#define RC_STR(rc) ((rc) == 0 ? "OK" : "ERROR")

#define PRINT_RESULT(func, rc) \
	printk("[MQTT] func: %s: %d <%s>\n", (func), rc, RC_STR(rc))

#define SUCCESS_OR_EXIT(rc) { if (rc != 0) { return 1; } }

///////////////////////////////////////////////////////////////////////////////

bool *send_ref;

void mqtt_set_send(bool *send)
{
    send_ref = send;
}

static void prepare_fds(struct mqtt_client *client)
{
	if (client->transport.type == MQTT_TRANSPORT_NON_SECURE) {
		fds[0].fd = client->transport.tcp.sock;
	}

	fds[0].events = ZSOCK_POLLIN;
	nfds = 1;
}

static void clear_fds(void)
{
	nfds = 0;
}

static int wait(int timeout)
{
	int ret = 0;

	if (nfds > 0) {
		ret = zsock_poll(fds, nfds, timeout);
		if (ret < 0) {
			printk("[MQTT] ERROR:poll error: %d\n", errno);
		}
	}

	return ret;
}

void mqtt_evt_handler(struct mqtt_client *const client,
		      const struct mqtt_evt *evt)
{
	int err;

	switch (evt->type) {
	case MQTT_EVT_CONNACK:
		if (evt->result != 0) {
			printk("[MQTT] ERROR: connect failed %d\n", evt->result);
			break;
		}

		connected = true;
		printk("[MQTT]:  client connected!\n");

		break;

	case MQTT_EVT_DISCONNECT:
		printk("[MQTT]:  client disconnected %d\n", evt->result);

		connected = false;
		clear_fds();

		break;

	case MQTT_EVT_PUBACK:
		if (evt->result != 0) {
			printk("[MQTT] ERROR: PUBACK error %d\n", evt->result);
			break;
		}

		printk("[MQTT]: PUBACK packet id: %u\n", evt->param.puback.message_id);

		break;

	case MQTT_EVT_PUBREC:
		if (evt->result != 0) {
			printk("[MQTT] ERROR: PUBREC error %d\n", evt->result);
			break;
		}

		printk("[MQTT]: PUBREC packet id: %u\n", evt->param.pubrec.message_id);

		const struct mqtt_pubrel_param rel_param = {
			.message_id = evt->param.pubrec.message_id
		};

		err = mqtt_publish_qos2_release(client, &rel_param);
		if (err != 0) {
			printk("[MQTT] ERROR:Failed to send MQTT PUBREL: %d\n", err);
		}

		break;

	case MQTT_EVT_PUBCOMP:
		if (evt->result != 0) {
			printk("[MQTT] ERROR: PUBCOMP error %d\n", evt->result);
			break;
		}

		printk("[MQTT]: PUBCOMP packet id: %u\n",
			evt->param.pubcomp.message_id);

		break;

	case MQTT_EVT_PINGRESP:
		printk("[MQTT]: PINGRESP packet\n");
		break;

    case MQTT_EVT_PUBLISH:
        if (evt->result != 0) {
            printk("[MQTT] Error: PUBLISH error %d\n", evt->result);
        }

        char buffer[1024];
        int rc = mqtt_read_publish_payload(client, buffer, sizeof(buffer));
        if (rc < 0)
        {
            printk("[MQTT] Error: failed to read published payload: %d\n", rc);
        }

        /* printk("[MQTT] Reveived: %s\nPublish Temperature ...\n", buffer); */
        printk("[MQTT] Reveived: %s\n", buffer);

        // publish temperature if we receive something on the sub-topic
        // TODO: Publish TEMP
        *send_ref = true;

        break;

	default:
		break;
	}
}

static char *get_mqtt_payload(double temp)
{
	// static APP_DMEM char payload[] = "DOORS:OPEN_QoSx";
	static APP_DMEM char payload[50];

    if (temp != 0)
    {
        snprintf(payload, 50, "Temperature: %f", temp);
    }
    else {
        snprintf(payload, 50, "no temperature value availible");
    }

	// payload[strlen(payload) - 1] = '0' + qos;

	return payload;
}

static char *get_mqtt_topic(void)
{
	return MQTT_TOPIC;
}

static char *get_mqtt_sub_topic(void)
{
	return MQTT_SUB_TOPIC;
}

static int sub_topic(struct mqtt_client *client, enum mqtt_qos qos)
{
    struct mqtt_topic topic;
    topic.qos = qos;
    topic.topic.utf8 = (uint8_t *)get_mqtt_sub_topic();
    topic.topic.size = strlen(topic.topic.utf8);

    struct mqtt_subscription_list subscription_list = {
        .list = &topic,
        .list_count = 1,
        .message_id = 1 // ???
    };

    return mqtt_subscribe(client, &subscription_list);
}

static int publish(struct mqtt_client *client, enum mqtt_qos qos, double temp)
{
	struct mqtt_publish_param param;

	param.message.topic.qos = qos;
	param.message.topic.topic.utf8 = (uint8_t *)get_mqtt_topic();
	param.message.topic.topic.size =
			strlen(param.message.topic.topic.utf8);
	param.message.payload.data = get_mqtt_payload(temp);
	param.message.payload.len =
			strlen(param.message.payload.data);
	param.message_id = sys_rand32_get();
	param.dup_flag = 0U;
	param.retain_flag = 0U;

	return mqtt_publish(client, &param);
}



static void broker_init(void)
{
	struct sockaddr_in *broker4 = (struct sockaddr_in *)&broker;

	broker4->sin_family = AF_INET;
	broker4->sin_port = htons(SERVER_PORT);
	zsock_inet_pton(AF_INET, SERVER_ADDR, &broker4->sin_addr);
}

static void rand_string(char *str, int start, int size)
{
    const char charset[] = "abcdefghijklmnopqrstuvwxyzABCDEFGHIJK";
    if (size) {
        --size;
        for (int n = start; n < size; n++) {
            int key =  sys_rand32_get() % (int) (sizeof charset - 1);
            str[n] = charset[key];
        }
        str[size] = '\0';
    }
    return ;
}

static void client_init(struct mqtt_client *client)
{
	mqtt_client_init(client);

	broker_init();
	memcpy(clientID, MQTT_CLIENTID, MQTT_CLIENTID_STRLENGTH);
	rand_string(clientID, MQTT_CLIENTID_STRLENGTH, MQTT_CLIENTID_TOTAL_LENGTH-1);
	printk("ClientID: %s\n", clientID);

	/* MQTT client configuration */
	client->broker = &broker;
	client->evt_cb = mqtt_evt_handler;
	client->client_id.utf8 = (uint8_t *)clientID;
	client->client_id.size = strlen(clientID);
	client->password = NULL;
	client->user_name = NULL;
	client->protocol_version = MQTT_VERSION_3_1_1;


	/* MQTT buffers configuration */
	client->rx_buf = rx_buffer;
	client->rx_buf_size = sizeof(rx_buffer);
	client->tx_buf = tx_buffer;
	client->tx_buf_size = sizeof(tx_buffer);

	/* MQTT transport configuration */

#if defined(CONFIG_MQTT_LIB_WEBSOCKET)
	client->transport.type = MQTT_TRANSPORT_NON_SECURE_WEBSOCKET;
	client->transport.websocket.config.host = SERVER_ADDR;
	client->transport.websocket.config.url = "/mqtt";
	client->transport.websocket.config.tmp_buf = temp_ws_rx_buf;
	client->transport.websocket.config.tmp_buf_len =
						sizeof(temp_ws_rx_buf);
	client->transport.websocket.timeout = 5 * MSEC_PER_SEC;
#else
	client->transport.type = MQTT_TRANSPORT_NON_SECURE;
#endif

}

/* In this routine we block until the connected variable is 1 */
static int try_to_connect(struct mqtt_client *client)
{
	int rc, i = 0;

	while (i++ < APP_CONNECT_TRIES && !connected) {
		printk("[MQTT]: Client init\n");
		client_init(client);

		printk("[MQTT]: connecting\n");
		rc = mqtt_connect(client);

		if (rc != 0) {
			PRINT_RESULT("mqtt_connect", rc);
			k_sleep(K_MSEC(APP_SLEEP_MSECS));
			continue;
		}

		prepare_fds(client);

		if (wait(APP_CONNECT_TIMEOUT_MS)) {
			mqtt_input(client);
		}

		if (!connected) {
			mqtt_abort(client);
		}

        rc = sub_topic(client, MQTT_QOS_0_AT_MOST_ONCE);

        if (rc != 0) {
            PRINT_RESULT("sub_topic", rc);
			k_sleep(K_MSEC(APP_SLEEP_MSECS));
			continue;
        }
        else {
            printk("[MQTT] Subscribed to topic '%s' with QOS=%d\n",
                get_mqtt_sub_topic(), MQTT_QOS_0_AT_MOST_ONCE);
        }
	}

	if (connected) {
		return 0;
	}

	return -EINVAL;
}

static int process_mqtt_and_sleep(struct mqtt_client *client, int timeout)
{
	int64_t remaining = timeout;
	int64_t start_time = k_uptime_get();
	int rc;

	while (remaining > 0 && connected) {
		if (wait(remaining)) {
			rc = mqtt_input(client);
			if (rc != 0) {
				PRINT_RESULT("mqtt_input", rc);
				return rc;
			}
		}

		rc = mqtt_live(client);
		if (rc != 0 && rc != -EAGAIN) {
			PRINT_RESULT("mqtt_live", rc);
			return rc;
		} else if (rc == 0) {
			rc = mqtt_input(client);
			if (rc != 0) {
				PRINT_RESULT("mqtt_input", rc);
				return rc;
			}
		}

		remaining = timeout + start_time - k_uptime_get();
	}

	return 0;
}


int mqtt_handler_connect(void)
{
	int rc;

	printk("[MQTT]: attempting to connect ...\n");
	rc = try_to_connect(&client_ctx);
	PRINT_RESULT("try_to_connect", rc);
	return rc;
}

int mqtt_handler_publish(double temp)
{
	int rc;

	rc = mqtt_ping(&client_ctx);
	PRINT_RESULT("mqtt_ping", rc);
	if (rc != 0)
	{
		return rc;
	}

	rc = process_mqtt_and_sleep(&client_ctx, APP_SLEEP_MSECS);
	if (rc != 0)
	{
		return rc;
	}

	rc = publish(&client_ctx, MQTT_QOS_0_AT_MOST_ONCE, temp);
	PRINT_RESULT("publish", rc);
	if (rc != 0)
	{
		return rc;
	}

	rc = process_mqtt_and_sleep(&client_ctx, APP_SLEEP_MSECS);

	return rc;
}

int mqtt_handler_keep_alive()
{
    int rc;

	rc = mqtt_ping(&client_ctx);
	PRINT_RESULT("mqtt_ping", rc);
	if (rc != 0)
	{
		return rc;
	}

	rc = process_mqtt_and_sleep(&client_ctx, APP_SLEEP_MSECS);
	return rc;
}

int mqtt_handler_disconnect()
{
	int rc = mqtt_disconnect(&client_ctx);
	PRINT_RESULT("mqtt_disconnect", rc);

	printk("[MQTT]: Bye!\n");

	return rc;
}
```

## src/wifi_handler.c
```c
/*
 * Copyright (c) 2020 Espressif Systems (Shanghai) Co., Ltd.
 *
 * SPDX-License-Identifier: Apache-2.0
 */

#include <zephyr.h>
#include <sys/printk.h>
#include <esp_wifi.h>
#include <esp_timer.h>
#include <esp_event.h>

#include <net/net_if.h>
#include <net/net_core.h>
#include <net/net_context.h>
#include <net/net_mgmt.h>

#include <logging/log.h>

#include "handlers.h"

LOG_MODULE_REGISTER(esp32_wifi_sta, LOG_LEVEL_DBG);

static struct net_mgmt_event_callback dhcp_cb;
static uint8_t connected ;

static void handler_cb(struct net_mgmt_event_callback *cb,
		    uint32_t mgmt_event, struct net_if *iface)
{
	if (mgmt_event != NET_EVENT_IPV4_DHCP_BOUND) {
		return;
	}

	char buf[NET_IPV4_ADDR_LEN];

	LOG_INF("Your address: %s",
		log_strdup(net_addr_ntop(AF_INET,
				   &iface->config.dhcpv4.requested_ip,
				   buf, sizeof(buf))));
	LOG_INF("Lease time: %u seconds",
			iface->config.dhcpv4.lease_time);
	LOG_INF("Subnet: %s",
		log_strdup(net_addr_ntop(AF_INET,
					&iface->config.ip.ipv4->netmask,
					buf, sizeof(buf))));
	LOG_INF("Router: %s",
		log_strdup(net_addr_ntop(AF_INET,
						&iface->config.ip.ipv4->gw,
						buf, sizeof(buf))));
    connected = 1;
}

void wifi_handler_connect(bool wait_for_connection)
{
	struct net_if *iface;
    connected =0;
	printk("Initiating Wifi connection\n");
	net_mgmt_init_event_callback(&dhcp_cb, handler_cb,
				     NET_EVENT_IPV4_DHCP_BOUND);

	net_mgmt_add_event_callback(&dhcp_cb);

	iface = net_if_get_default();
	if (!iface) {
		LOG_ERR("wifi interface not available");
		return;
	}

	net_dhcpv4_start(iface);

	if (!IS_ENABLED(CONFIG_ESP32_WIFI_STA_AUTO)) {
		wifi_config_t wifi_config = {
			.sta = {
				.ssid = CONFIG_ESP32_WIFI_SSID,
				.password = CONFIG_ESP32_WIFI_PASSWORD,
			},
		};

		esp_err_t ret = esp_wifi_set_mode(WIFI_MODE_STA);

		ret |= esp_wifi_set_config(ESP_IF_WIFI_STA, &wifi_config);
		ret |= esp_wifi_connect();
		if (ret != ESP_OK) {
			LOG_ERR("connection failed");
		}
	}

    if(wait_for_connection)
    {    
        printk("Waiting for Wifi connection\n");
        while(connected == 0)
        {
            k_msleep(1000);
        }
        printk("Wifi Connected\n");
    }
}
```
